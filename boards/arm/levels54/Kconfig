## boards/arm/levels54/Kconfig
```kconfig
config BOARD_ENABLE_DCDC
  bool "Enable DCDC mode"
  select SOC_DCDC_NRF52X
  default y
  depends on (BOARD_LEVELS54_LEFT || BOARD_LEVELS54_RIGHT)

config BOARD_ENABLE_DCDC_HV
  bool "High voltage DCDC converter"
  default y
  depends on (BOARD_LEVELS54_LEFT || BOARD_LEVELS54_RIGHT)
```

## boards/arm/levels54/Kconfig.board
```kconfig
# Copyright (c) 2025 Vincent Franco
# SPDX-License-Identifier: MIT

config BOARD_LEVELS54_LEFT
  bool "Levels54 Left"
  depends on SOC_NRF52840_QIAA

config BOARD_LEVELS54_RIGHT
  bool "Levels54 Right"
  depends on SOC_NRF52840_QIAA
```

## boards/arm/levels54/Kconfig.defconfig
```kconfig
# Copyright (c) 2025 Vincent Franco
# SPDX-License-Identifier: MIT

if BOARD_LEVELS54_LEFT

config ZMK_KEYBOARD_NAME
  default "Levels54"

config BOARD
  default "level54 left"

endif # BOARD_LEVELS54_LEFT

if BOARD_LEVELS54_RIGHT

config ZMK_SPLIT_ROLE_CENTRAL
  default y

config BOARD
  default "level54 right"

endif # BOARD_LEVELS54_RIGHT

if BOARD_LEVELS54_LEFT || BOARD_LEVELS54_RIGHT

config ZMK_SPLIT
  default y

config BT_CTLR
  default BT

config PINCTRL
  default y

if USB

config USB_NRFX
  default y

config USB_DEVICE_STACK
  default y

endif # USB

config SPI
  default y

endif # BOARD_LEVELS54_LEFT ||  BOARD_LEVELS54_RIGHT
```

## boards/arm/levels54/levels54_left_defconfig
```kconfig
# Copyright (c) 2025 Vincent Franco
# SPDX-License-Identifier: MIT

CONFIG_SOC_SERIES_NRF52X=y
CONFIG_SOC_NRF52840_QIAA=y
CONFIG_BOARD_LEVELS54_LEFT=y

# Enable MPU
CONFIG_ARM_MPU=y
CONFIG_PINCTRL=y

# enable GPIO
CONFIG_GPIO=y

# Flash config
CONFIG_USE_DT_CODE_PARTITION=y
CONFIG_BUILD_OUTPUT_UF2=y
CONFIG_MPU_ALLOW_FLASH_WRITE=y
CONFIG_NVS=y
CONFIG_SETTINGS_NVS=y
CONFIG_FLASH=y
CONFIG_FLASH_PAGE_LAYOUT=y
CONFIG_FLASH_MAP=y

CONFIG_ZMK_BLE=y

# Enable external crystal
CONFIG_CLOCK_CONTROL_NRF_K32SRC_XTAL=y
CONFIG_CLOCK_CONTROL_NRF_K32SRC_30PPM=y

# Work-around for Windows bug with battery notifications
CONFIG_BT_GATT_ENFORCE_SUBSCRIPTION=n
CONFIG_BT_CTLR_TX_PWR_PLUS_8=y

CONFIG_BT_CTLR_PHY_2M=n

# The full two-byte consumer report space has compatibility issues with some
# operating systems, most notably macOS. Use the more basic single-byte usage
# space.
CONFIG_ZMK_HID_CONSUMER_REPORT_USAGES_BASIC=y

CONFIG_USB_DEVICE_MANUFACTURER="Good Great Grand Wonderful"
CONFIG_USB_DEVICE_PID=0xA122
CONFIG_USB_DEVICE_VID=0xA241

CONFIG_BT_DIS_PNP_PID=0xA122
CONFIG_BT_DIS_PNP_VID=0xA241
CONFIG_BT_DIS_MANUF="Good Great Grand Wonderful"
CONFIG_BT_DIS_MODEL="Levels54"

# Final boss config
CONFIG_SPI=y
CONFIG_INPUT=y
CONFIG_PMW3610=y
CONFIG_ZMK_POINTING=y
CONFIG_ZMK_POINTING_SMOOTH_SCROLLING=n
CONFIG_PMW3610_REPORT_INTERVAL_MIN=10

#CONFIG_BT_PERIPHERAL_PREF_MAX_INT=9
#CONFIG_BT_PERIPHERAL_PREF_LATENCY=16
#CONFIG_BT_BUF_ACL_TX_COUNT=32
#CONFIG_BT_L2CAP_TX_BUF_COUNT=32

#CONFIG_SPI_LOG_LEVEL_DBG=y
CONFIG_PMW3610_ANTI_WARP=y
CONFIG_PMW3610_ANTI_WARP_THRES=100
CONFIG_PMW3610_INIT_POWER_UP_EXTRA_DELAY_MS=10
CONFIG_PMW3610_REPORT_INTERVAL_MIN=0
CONFIG_PMW3610_SMART_ALGORITHM=y
CONFIG_PMW3610_SQUAL_LOG=n
CONFIG_PMW3610_SQUAL_LOG_INTERVAL=250
CONFIG_PMW3610_REST1_SAMPLE_TIME_MS=35
CONFIG_PMW3610_REST2_SAMPLE_TIME_MS=65
CONFIG_PMW3610_REST3_SAMPLE_TIME_MS=250
CONFIG_PMW3610_RUN_DOWNSHIFT_TIME_MS=2500
CONFIG_PMW3610_REST1_DOWNSHIFT_TIME_MS=15000
CONFIG_PMW3610_REST2_DOWNSHIFT_TIME_MS=150000
CONFIG_PMW3610_IGNORE_FIRST_N=15
CONFIG_PMW3610_IGNORE_AFTER_REST=n
CONFIG_ZMK_INPUT_PROCESSOR_REPORT_RATE_LIMIT=y
CONFIG_ZMK_INPUT_PROCESSOR_REPORT_RATE_LIMIT_DEFAULT=2

CONFIG_ZMK_SLEEP=y

# Enable RGB battery indication
CONFIG_RGBLED_WIDGET=y
```

## boards/arm/levels54/levels54_right_defconfig
```kconfig
CONFIG_SOC_SERIES_NRF52X=y
CONFIG_SOC_NRF52840_QIAA=y
CONFIG_BOARD_LEVELS54_RIGHT=y

# Enable MPU
CONFIG_ARM_MPU=y
CONFIG_PINCTRL=y

# enable GPIO
CONFIG_GPIO=y

# Flash config
CONFIG_USE_DT_CODE_PARTITION=y
CONFIG_BUILD_OUTPUT_UF2=y
CONFIG_MPU_ALLOW_FLASH_WRITE=y
CONFIG_NVS=y
CONFIG_SETTINGS_NVS=y
CONFIG_FLASH=y
CONFIG_FLASH_PAGE_LAYOUT=y
CONFIG_FLASH_MAP=y

# Enable 32kHz crystal
CONFIG_CLOCK_CONTROL_NRF_K32SRC_XTAL=y
CONFIG_CLOCK_CONTROL_NRF_K32SRC_150PPM=y

CONFIG_ZMK_BLE=y
CONFIG_ZMK_USB=y

# Work-around for Windows bug with battery notifications
CONFIG_BT_GATT_ENFORCE_SUBSCRIPTION=n
CONFIG_BT_CTLR_TX_PWR_PLUS_8=y

# The full two-byte consumer report space has compatibility issues with some
# operating systems, most notably macOS. Use the more basic single-byte usage
# space.
CONFIG_ZMK_HID_CONSUMER_REPORT_USAGES_BASIC=y

CONFIG_USB_DEVICE_MANUFACTURER="Good Great Grand Wonderful"
CONFIG_USB_DEVICE_PID=0xA123
CONFIG_USB_DEVICE_VID=0xA241

CONFIG_BT_DIS_PNP_PID=0xA123
CONFIG_BT_DIS_PNP_VID=0xA241
CONFIG_BT_DIS_MANUF="Good Great Grand Wonderful"
CONFIG_BT_DIS_MODEL="Levels 54 rt"

# Final boss config
CONFIG_SPI=y
CONFIG_INPUT=y
CONFIG_PMW3610=y
CONFIG_ZMK_POINTING=y
CONFIG_ZMK_POINTING_SMOOTH_SCROLLING=n

#CONFIG_PMW3610_SWAP_XY=y
#CONFIG_PMW3610_INVERT_X=y
#CONFIG_PMW3610_INVERT_Y=y
CONFIG_PMW3610_REPORT_INTERVAL_MIN=10

#CONFIG_BT_PERIPHERAL_PREF_MAX_INT=9
#CONFIG_BT_PERIPHERAL_PREF_LATENCY=16
#CONFIG_BT_BUF_ACL_TX_COUNT=32
#CONFIG_BT_L2CAP_TX_BUF_COUNT=32

#CONFIG_SPI_LOG_LEVEL_DBG=y
#define ZMK_POINTING_DEFAULT_MOVE_VAL 1500 
#define ZMK_POINTING_DEFAULT_SCRL_VAL 20
CONFIG_PMW3610_INIT_POWER_UP_EXTRA_DELAY_MS=1000
CONFIG_PMW3610_RUN_DOWNSHIFT_TIME_MS=3264
CONFIG_PMW3610_REST1_SAMPLE_TIME_MS=20
#CONFIG_PMW3610_REST1_SAMPLE_TIME_MS=100
#CONFIG_PMW3610_REST2_SAMPLE_TIME_MS=200
CONFIG_PMW3610_REST3_SAMPLE_TIME_MS=300
#CONFIG_PMW3610_RUN_DOWNSHIFT_TIME_MS=500
#CONFIG_PMW3610_REST1_DOWNSHIFT_TIME_MS=3000
#CONFIG_PMW3610_REST2_DOWNSHIFT_TIME_MS=30000

CONFIG_ZMK_SLEEP=y
```

## boards/shields/arcduo/Kconfig.defconfig
```kconfig
if SHIELD_ARCDUO_DONGLE

config ZMK_KEYBOARD_NAME
  default "ArcDuo"

config ZMK_SPLIT_ROLE_CENTRAL
  default y

config ZMK_SPLIT_BLE_CENTRAL_PERIPHERALS
    default 2

endif

if SHIELD_ARCDUO_LEFT || SHIELD_ARCDUO_RIGHT || SHIELD_ARCDUO_DONGLE

config ZMK_SPLIT
  default y

endif
```

## boards/shields/arcduo/Kconfig.shield
```kconfig
config SHIELD_ARCDUO_DONGLE
  def_bool $(shields_list_contains,arcduo_dongle)

config SHIELD_ARCDUO_LEFT
  def_bool $(shields_list_contains,arcduo_left)

config SHIELD_ARCDUO_RIGHT
  def_bool $(shields_list_contains,arcduo_right)
```

## config/west.yml
```yaml
manifest:
  defaults:
    revision: v0.3
  remotes:
    - name: zmkfirmware
      url-base: https://github.com/zmkfirmware
    - name: Good-Great-Grand-Wonderful
      url-base: https://github.com/Good-Great-Grand-Wonderful
  projects:
    - name: zmk
      remote: zmkfirmware
      import: app/west.yml
    - name: gggw-zmk-keebs
      remote: Good-Great-Grand-Wonderful
      revision: main
      import: config/west.yml
  self:
    path: config
```
